// SPDX-License-Identifier: GPL-2.0-only
/*
 * Copyright (c) 2018-2019, The Linux Foundation. All rights reserved.
 */

#include "../lito-caymanlm_common/lito-caymanlm_common-panel.dtsi"


&dsi_sw43103_pv_fhd_dsc_cmd  {
	lge,blmap = <
		0
		6 11 17 22 28 34 39 45 50 56 62 67 73 79 84
		90 95 101 107 112 118 123 129 135 140 146 151 157 163 168
		174 179 185 191 196 202 208 213 219 224 230 236 241 247 252
		258 264 269 275 280 286 292 297 303 308 314 320 325 331 336
		342 348 353 359 365 370 376 381 387 393 398 404 409 415 421
		426 432 437 443 449 454 460 465 471 477 482 488 494 499 505
		510 516 522 527 533 538 544 550 555 561 566 572 578 583 589
		594 600 606 611 617 623 628 634 639 645 651 656 662 667 673
		679 684 690 695 701 707 712 718 723 729 735 740 746 752 757
		763 768 774 780 785 791 796 802 808 813 819 824 830 836 841
		847 852 858 864 869 875 880 886 892 897 903 909 914 920 925
		931 937 942 948 953 959 965 970 976 981 987 993 998 1004 1009
		1015 1021 1026 1032 1038 1043 1049 1054 1060 1066 1071 1077 1082 1088 1094
		1099 1105 1110 1116 1122 1127 1133 1138 1144 1150 1155 1161 1167 1172 1178
		1183 1189 1195 1200 1206 1211 1217 1223 1228 1234 1239 1245 1251 1256 1262
		1267 1273 1279 1284 1290 1295 1301 1307 1312 1318 1324 1329 1335 1340 1346
		1352 1357 1363 1368 1374 1380 1385 1391 1396 1402 1408 1413 1419 1424 1430
		1436 1441 1447 1453 1458 1464 1469 1475 1481 1486 1492 1497 1503 1509 1514
		1520 1525 1531 1537 1542 1548 1553 1559 1565 1570 1576 1582 1587 1593 1598
		1604 1610 1615 1621 1626 1632 1638 1643 1649 1654 1660 1666 1671 1677 1682
		1688 1694 1699 1705 1711 1716 1722 1727 1733 1739 1744 1750 1755 1761 1767
		1772 1778 1783 1789 1795 1800 1806 1811 1817 1823 1828 1834 1839 1845 1851
		1856 1862 1868 1873 1879 1884 1890 1896 1901 1907 1912 1918 1924 1929 1935
		1940 1946 1952 1957 1963 1968 1974 1980 1985 1991 1997 2002 2008 2013 2019
		2025 2030 2036 2041 2047
	>;

	lge,blmap-daylight = <
		0
		5 5 5 5 5 5 5 5 5 5 5 6 6 7 7 7 8 8 8 9
		9 10 10 10 11 11 12 12 12 13 13 13 14 14 15 15 15 16 16 17
		17 17 18 18 19 19 19 20 20 21 21 21 22 22 23 23 23 24 24 25
		25 27 29 31 33 35 38 40 42 44 46 48 50 52 54 56 58 60 63 65
		67 70 73 77 75 78 82 85 88 92 95 98 101 105 108 111 115 118 121 125
		128 131 134 138 141 144 148 151 157 163 169 175 182 188 194 200 206 212 218 224
		231 237 243 249 255 261 267 273 279 286 292 298 304 310 317 324 331 339 346 353
		360 366 373 381 388 395 402 409 416 424 431 438 445 452 459 466 474 481 489 502
		514 527 539 552 564 577 589 602 614 627 640 652 665 677 690 702 715 727 740 752
		765 777 790 803 816 829 842 855 869 882 895 908 921 934 947 960 973 986 999 1012
		1026 1039 1052 1065 1078 1091 1104 1121 1138 1155 1172 1189 1206 1223 1240 1257 1274 1291 1308 1326
		1343 1360 1377 1394 1411 1428 1445 1462 1479 1496 1513 1530 1552 1575 1597 1620 1642 1665 1687 1710
		1732 1755 1777 1800 1822 1845 1867 1890 1912 1935 1957 1980 2002 2025 2047 2047 2047 2047 2047 2047
		2047 2047 2047 2047 2047 2047 2047 2047 2047 2047 2047 2047 2047 2047 2047 2047 2047 2047 2047 2047
		2047 2047 2047 2047 2047 2047 2047 2047 2047 2047 2047 2047 2047 2047 2047 2047 2047 2047 2047 2047
		2047 2047 2047 2047 2047 2047 2047 2047 2047 2047 2047 2047 2047 2047 2047 2047 2047 2047 2047 2047
		2047 2047 2047 2047 2047 2047 2047 2047 2047 2047 2047 2047 2047 2047 2047 2047 2047 2047 2047 2047
		2047 2047 2047 2047 2047 2047 2047 2047 2047 2047 2047 2047 2047 2047 2047 2047 2047 2047 2047 2047
		2047 2047 2047 2047 2047
	>;
};
